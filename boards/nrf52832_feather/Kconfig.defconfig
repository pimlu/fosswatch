## boards/nrf52832_feather/Kconfig.nrf52832_feather
```kconfig
# nRF52832-FEATHER board configuration

# Copyright (c) 2018 makerdiary.com.
# SPDX-License-Identifier: Apache-2.0

config BOARD_NRF52832_FEATHER
	select SOC_NRF52832_QFAA
```

## boards/nrf52832_feather/board.yml
```yaml
board:
  name: nrf52832_feather
  full_name: nRF52832-feather
  vendor: makerdiary
  socs:
  - name: nrf52832
```
